## app/buzzer_test/Kconfig
```kconfig
#
# Contest 2026 team 094 buzzer test app
#

config LVX_USE_DEMO_CONTEST2026_094_BUZZER_TEST
	bool "Contest 2026 team 094 buzzer test"
	default n
	depends on PWM
	---help---
		Enable the buzzer_test NSH command for the demo88-nor onboard buzzer.
		The command always stops PWM1 after a bounded test duration.
```

## app/fb_test/Kconfig
```kconfig
#
# Contest 2026 team 094 framebuffer test app
#

config LVX_USE_DEMO_CONTEST2026_094_FB_TEST
	bool "Contest 2026 team 094 framebuffer test"
	default n
	depends on VIDEO_FB && FB_UPDATE
	---help---
		Enable the fb_test NSH command. It validates /dev/fb0 and draws an
		RGB565 color-bar pattern on the demo88-nor 1024x600 LVDS panel.
```

## app/flash_test/Kconfig
```kconfig
#
# Contest 2026 team 094 SPI NOR read-only test
#

config LVX_USE_DEMO_CONTEST2026_094_FLASH_TEST
	bool "Contest 2026 team 094 SPI NOR read-only test"
	default n
	depends on MTD && USING_SFUD && AIC_SPINOR_DRV
	---help---
		Enable flash_test for JEDEC/SFDP information, partition listing,
		bounded reads, and non-destructive double-read verification.
```

## app/gt911_test/Kconfig
```kconfig
#
# Contest 2026 team 094 GT911 probe app
#

config LVX_USE_DEMO_CONTEST2026_094_GT911_TEST
	bool "Contest 2026 team 094 GT911 test"
	default n
	depends on I2C_DRIVER && D13X_TOUCH_GT911 && VIDEO_FB && FB_UPDATE
	---help---
		Enable the gt911_test NSH command. It probes the onboard GT911 on
		/dev/i2c2, reports version/configuration data, and can monitor raw
		five-point touch frames without enabling the touch input stack. A
		visual mode draws targets and five-color trails on /dev/fb0.
```

## app/lvgl_test/Kconfig
```kconfig
#
# Contest 2026 team 094 LVGL framebuffer test app
#

config LVX_USE_DEMO_CONTEST2026_094_LVGL_TEST
	bool "Contest 2026 team 094 LVGL framebuffer test"
	default n
	depends on GRAPHICS_LVGL && LV_USE_NUTTX
	depends on VIDEO_FB && FB_UPDATE
	depends on INPUT_TOUCHSCREEN && LV_USE_NUTTX_TOUCHSCREEN
	depends on D13X_KEYADC
	---help---
		Enable the lvgl_test NSH command. It renders a bounded interactive
		1024x600 LVGL test page through /dev/fb0, /dev/input0, and the
			separate /dev/dpad focus-navigation device. WAKEUP is reserved
			for system power management.
```

## app/mic_test/Kconfig
```kconfig
#
# Contest 2026 team 094 microphone test app
#

config LVX_USE_DEMO_CONTEST2026_094_MIC_TEST
	bool "Contest 2026 team 094 microphone test"
	default n
	depends on AUDIO && SYSTEM_NXRECORDER && SYSTEM_NXPLAYER
	---help---
		Enable the mic_test NSH command for bounded DMIC WAV recording,
		storage in /data, and playback through /dev/audio/pcm0p.
```

## app/pm_test/Kconfig
```kconfig
#
# Contest 2026 team 094 power-management wake test
#

config LVX_USE_DEMO_CONTEST2026_094_PM_TEST
	bool "Contest 2026 team 094 PM wake test"
	default n
	depends on D13X_WAKEUP_PM && VIDEO_FB
	---help---
		Enable the bounded pm_test wake command. The first milestone powers
		off the display pipeline and verifies PD.15 falling-edge wake and
		display restore without changing CPU or PLL clocks.
```

## app/recorder_app/Kconfig
```kconfig
#
# Contest 2026 team 094 LVGL recorder app
#

config LVX_USE_DEMO_CONTEST2026_094_RECORDER_APP
	bool "Contest 2026 team 094 LVGL WAV recorder"
	default n
	depends on GRAPHICS_LVGL && LV_USE_NUTTX
	depends on VIDEO_FB && FB_UPDATE
	depends on INPUT_TOUCHSCREEN && LV_USE_NUTTX_TOUCHSCREEN
	depends on AUDIO && SYSTEM_NXRECORDER && SYSTEM_NXPLAYER
	depends on D13X_SDMC1 && FS_FATFS
	---help---
		Enable the recorder NSH command. It opens a touch LVGL UI,
		records WAV files to /data/sdcard, plays the latest recording through
		/dev/audio/pcm0p, and renders an amplitude waveform.

config LVX_USE_DEMO_CONTEST2026_094_RECORDER_STACKSIZE
	int "Recorder UI task stack size"
	default 16384
	depends on LVX_USE_DEMO_CONTEST2026_094_RECORDER_APP
	help
		Stack size for the recorder LVGL task. LVGL requires at least 8192
		bytes on NuttX.
```

## app/rtc_test/Kconfig
```kconfig
#
# Contest 2026 team 094 RTC test
#

config LVX_USE_DEMO_CONTEST2026_094_RTC_TEST
	bool "Contest 2026 team 094 RTC test"
	default n
	depends on D13X_RTC && RTC
	---help---
		Enable the rtc_test command for counter, time-setting, alarm IRQ,
		and battery-backed retention validation.
```

## app/speaker_test/Kconfig
```kconfig
#
# Contest 2026 team 094 speaker test app
#

config LVX_USE_DEMO_CONTEST2026_094_SPEAKER_TEST
	bool "Contest 2026 team 094 speaker test"
	default n
	depends on AUDIO && SYSTEM_NXPLAYER
	---help---
		Enable the speaker_test NSH command for the demo88-nor DSPK1
		output and /dev/audio/pcm0p.
```

## app/tf_test/Kconfig
```kconfig
#
# Contest 2026 team 094 TF-card test app
#

config LVX_USE_DEMO_CONTEST2026_094_TF_TEST
	bool "Contest 2026 team 094 TF-card test"
	default n
	depends on MMCSD && FS_FATFS
	---help---
		Enable the tf_test NSH command for /dev/mmcsd1 and /sdcard.
		The test never formats the card and only modifies tf_test.bin.
```

## app/wdt_test/Kconfig
```kconfig
#
# Contest 2026 team 094 watchdog test
#

config LVX_USE_DEMO_CONTEST2026_094_WDT_TEST
	bool "Contest 2026 team 094 watchdog test"
	default n
	depends on D13X_WDT && WATCHDOG
	---help---
		Enable the bounded wdt_test command for /dev/watchdog0. Feed mode
		stops safely; reset mode requires an explicit confirmation argument.
```

## app/wifi_test/Kconfig
```kconfig
#
# Contest 2026 team 094 SDIO Wi-Fi probe app
#

config LVX_USE_DEMO_CONTEST2026_094_WIFI_TEST
	bool "Contest 2026 team 094 SDIO Wi-Fi probe"
	default n
	depends on D13X_SDMC0_WIFI
	---help---
		Enable the wifi_test NSH command for the demo88-nor SDMC0 Wi-Fi
		module. This only probes SDIO CMD5 and does not register wlan0.

config LVX_USE_DEMO_CONTEST2026_094_WIFI_AUTO_START
	bool "Auto start contest 094 Wi-Fi during board bringup"
	default n
	depends on LVX_USE_DEMO_CONTEST2026_094_WIFI_TEST
	---help---
		Automatically load Wi-Fi firmware, run bringup, and register wlan0
		during board bringup. Keep this disabled for fast NSH startup.
```

## board/d13x/demo88-nor/configs/nsh/defconfig
```kconfig
CONFIG_ARCH_RISCV=y
CONFIG_ARCH_CHIP_RISCV_CUSTOM=y
CONFIG_ARCH_CHIP_CUSTOM=y
CONFIG_ARCH_CHIP_CUSTOM_NAME="artinchip_d13x"
CONFIG_ARCH_CHIP_CUSTOM_DIR="../vendor/artinchip/chips/artinchips/d13x"
CONFIG_ARCH_CHIP_CUSTOM_DIR_RELPATH=y
CONFIG_ARCH_CHIP_D13X=y
CONFIG_ARCH_BOARD_CUSTOM=y
CONFIG_ARCH_BOARD_CUSTOM_NAME="demo88-nor"
CONFIG_ARCH_BOARD_CUSTOM_DIR="../vendor/artinchip/boards/d13x/demo88-nor"
CONFIG_ARCH_BOARD_CUSTOM_DIR_RELPATH=y
CONFIG_ARCH_INTERRUPTSTACK=4096
CONFIG_ARCH_BUTTONS=y
CONFIG_ARCH_IRQBUTTONS=y
CONFIG_AUDIO=y
CONFIG_AUDIO_BUFFER_NUMBYTES=8192
CONFIG_AUDIO_NUM_BUFFERS=2
CONFIG_AUDIO_EXCLUDE_FFORWARD=y
# CONFIG_AUDIO_EXCLUDE_PAUSE_RESUME is not set
CONFIG_AUDIO_EXCLUDE_REWIND=y
CONFIG_AUDIO_EXCLUDE_TONE=y
CONFIG_AUDIO_EXCLUDE_VOLUME=y
CONFIG_AUDIO_FORMAT_PCM=y
CONFIG_DMA=y
# CONFIG_AUDIO_FORMAT_AMR is not set
# CONFIG_AUDIO_FORMAT_MP3 is not set
# CONFIG_AUDIO_FORMAT_OPUS is not set
# CONFIG_AUDIO_FORMAT_SBC is not set
CONFIG_BINFMT_DISABLE=y
CONFIG_BOARD_EARLY_INITIALIZE=y
CONFIG_BOARD_LATE_INITIALIZE=y
CONFIG_BOARD_LOOPSPERMSEC=10000
CONFIG_BUILTIN=y
CONFIG_CONTEST2026_094_ANDY_BOARD_DEMO88_NOR=y
CONFIG_DEV_CONSOLE=y
CONFIG_D13X_I2C=y
CONFIG_D13X_I2C2=y
CONFIG_D13X_TOUCH=y
CONFIG_D13X_TOUCH_GT911=y
CONFIG_D13X_GT911_INPUT=y
CONFIG_D13X_WDT=y
CONFIG_D13X_KEYADC=y
CONFIG_D13X_WAKEUP_PM=y
CONFIG_D13X_PWM1=y
CONFIG_D13X_RTC=y
CONFIG_D13X_DISPLAY=y
CONFIG_D13X_SDMC0_WIFI=y
CONFIG_D13X_SDMC0_WIFI_POWER_GPIO="PD.7"
CONFIG_D13X_SDMC1=y
CONFIG_D13X_GMAC=y
CONFIG_DRIVERS_WIRELESS=y
CONFIG_DRIVERS_IEEE80211=y
CONFIG_DEBUG_FULLOPT=y
CONFIG_DEBUG_SYMBOLS=y
CONFIG_DEFAULT_SMALL=y
# CONFIG_DISABLE_PTHREAD is not set
# CONFIG_DISABLE_MQUEUE is not set
# CONFIG_DISABLE_ENVIRON is not set
# CONFIG_DISABLE_SIGNALS is not set
CONFIG_DRIVER_QSPI_HAL_EN=y
CONFIG_FS_PROCFS=y
CONFIG_FS_PROCFS_EXCLUDE_BLOCKS=y
CONFIG_FS_PROCFS_EXCLUDE_CPUINFO=y
# CONFIG_FS_PROCFS_EXCLUDE_MEMINFO is not set
# CONFIG_FS_PROCFS_EXCLUDE_NET is not set
# CONFIG_FS_PROCFS_EXCLUDE_PROCESS is not set
CONFIG_FS_PROCFS_EXCLUDE_TCBINFO=y
# CONFIG_FS_PROCFS_EXCLUDE_UPTIME is not set
CONFIG_FS_PROCFS_EXCLUDE_VERSION=y
CONFIG_FS_PROCFS_REGISTER=y
CONFIG_FS_LITTLEFS=y
CONFIG_FS_LITTLEFS_PROGRAM_SIZE_FACTOR=1
CONFIG_FS_LITTLEFS_READ_SIZE_FACTOR=1
CONFIG_FS_LITTLEFS_BLOCK_SIZE_FACTOR=1
CONFIG_FS_LITTLEFS_CACHE_SIZE_FACTOR=1
CONFIG_FS_FATFS=y
CONFIG_MBR_PARTITION=y
CONFIG_FILE_STREAM=y
CONFIG_GRAPHICS_LVGL=y
# CONFIG_GRAPHICS_INPUT_GETEVENT is not set
CONFIG_INPUT_BUTTONS=y
CONFIG_INPUT_BUTTONS_DEBOUNCE_DELAY=30
CONFIG_INPUT_BUTTONS_LOWER=y
CONFIG_IDLETHREAD_STACKSIZE=8192
CONFIG_INIT_ENTRYPOINT="nsh_main"
CONFIG_INIT_STACKSIZE=8192
CONFIG_LIBC_PERROR_STDOUT=y
CONFIG_LIBC_STRERROR=y
CONFIG_LIBM=y
# CONFIG_LVX_USE_DEMO_CONTEST2026_094_HELLO_APP is not set
# CONFIG_LVX_USE_DEMO_CONTEST2026_094_MIC_TEST is not set
# CONFIG_LVX_USE_DEMO_CONTEST2026_094_WIFI_TEST is not set
# CONFIG_LVX_USE_DEMO_CONTEST2026_094_WIFI_AUTO_START is not set
# CONFIG_LVX_USE_DEMO_CONTEST2026_094_RECORDER_APP is not set
CONFIG_LVX_USE_DEMO_CONTEST2026_094_TF_TEST=y
CONFIG_LV_CONF_MINIMAL=y
CONFIG_LV_DEF_REFR_PERIOD=50
CONFIG_LV_USE_FLEX=y
CONFIG_LV_USE_LIST=y
CONFIG_LV_FONT_DEFAULT_MONTSERRAT_16=y
CONFIG_LV_FONT_MONTSERRAT_24=y
CONFIG_LV_MEM_SIZE_KILOBYTES=64
CONFIG_LV_USE_BAR=y
CONFIG_LV_USE_BUTTON=y
CONFIG_LV_USE_LABEL=y
CONFIG_LV_USE_LOG=y
CONFIG_LV_USE_NUTTX=y
CONFIG_LV_USE_NUTTX_TOUCHSCREEN=y
CONFIG_LV_USE_SLIDER=y
CONFIG_LV_USE_SWITCH=y
CONFIG_MTD=y
CONFIG_MTD_BYTE_WRITE=y
CONFIG_MTD_PARTITION=y
CONFIG_MTD_PARTITION_NAMES=y
CONFIG_MM_REGIONS=2
CONFIG_MMCSD=y
CONFIG_MMCSD_SDIO=y
CONFIG_MMCSD_MULTIBLOCK_LIMIT=1
CONFIG_SDIO_BLOCKSETUP=y
# CONFIG_MMCSD_SPI is not set
# CONFIG_MMCSD_MMCSUPPORT is not set
# CONFIG_MMCSD_HAVE_WRITEPROTECT is not set
CONFIG_NET=y
CONFIG_NET_ARP=y
CONFIG_NET_BROADCAST=y
CONFIG_NETDEV_LATEINIT=y
CONFIG_NET_ETHERNET=y
CONFIG_NET_ETH_PKTSIZE=1514
CONFIG_NET_ICMP=y
CONFIG_NET_ICMP_SOCKET=y
CONFIG_NET_IPv4=y
CONFIG_NET_SOCKOPTS=y
CONFIG_NET_TCP=y
CONFIG_NET_UDP=y
CONFIG_NETDB_DNSCLIENT=y
CONFIG_NETDB_DNSSERVER_IPv4=y
CONFIG_NETDB_DNSSERVER_IPv4ADDR=0xc0a88901
CONFIG_NETUTILS_WEBCLIENT=y
CONFIG_NETUTILS_DHCPC=y
CONFIG_NETUTILS_DHCPC_BOOTP_FLAGS=0x8000
CONFIG_NETDEV_WIRELESS_IOCTL=y
CONFIG_NETINIT_DHCPC=y
CONFIG_NETINIT_DNS=y
CONFIG_NETINIT_DNSIPADDR=0xc0a88901
CONFIG_NETINIT_THREAD=y
CONFIG_NETINIT_THREAD_PRIORITY=110
CONFIG_NFILE_DESCRIPTORS_PER_BLOCK=6
CONFIG_MQ_MAXMSGSIZE=32
CONFIG_NSH_ARCHINIT=y
CONFIG_NSH_BUILTIN_APPS=y
# CONFIG_NSH_BUILTIN_AS_COMMAND is not set
CONFIG_NSH_CONSOLE=y
CONFIG_NSH_NETINIT=y
# CONFIG_NSH_DISABLE_CAT is not set
# CONFIG_NSH_DISABLE_CD is not set
# CONFIG_NSH_DISABLE_ERROR_PRINT is not set
# CONFIG_NSH_DISABLE_DF is not set
# CONFIG_NSH_DISABLE_ECHO is not set
# CONFIG_NSH_DISABLE_FDINFO is not set
# CONFIG_NSH_DISABLE_FREE is not set
# CONFIG_NSH_DISABLE_IFCONFIG is not set
# CONFIG_NSH_DISABLE_IFUPDOWN is not set
# CONFIG_NSH_DISABLE_MKDIR is not set
# CONFIG_NSH_DISABLE_MOUNT is not set
# CONFIG_NSH_DISABLE_RM is not set
# CONFIG_NSH_DISABLE_RMDIR is not set
# CONFIG_NSH_DISABLE_UMOUNT is not set
# CONFIG_NSH_DISABLE_HEXDUMP is not set
# CONFIG_NSH_DISABLE_LS is not set
# CONFIG_NSH_DISABLE_PIDOF is not set
# CONFIG_NSH_DISABLE_PS is not set
# CONFIG_NSH_DISABLE_PWD is not set
# CONFIG_NSH_DISABLE_SLEEP is not set
# CONFIG_NSH_DISABLE_TIME is not set
# CONFIG_NSH_DISABLE_UNAME is not set
# CONFIG_NSH_DISABLE_UPTIME is not set
# CONFIG_NSH_DISABLE_USLEEP is not set
# CONFIG_NSH_DISABLE_WGET is not set
CONFIG_NSH_READLINE=y
CONFIG_NSH_STRERROR=y
CONFIG_OTHER_UART_SERIALDRIVER=y
CONFIG_RAM_SIZE=1032192
CONFIG_RAM_START=0x30044000
CONFIG_RAW_BINARY=y
CONFIG_READLINE_CMD_HISTORY=y
CONFIG_READLINE_TABCOMPLETION=y
CONFIG_RR_INTERVAL=200
CONFIG_SCHED_HPWORK=y
CONFIG_SCHED_LPWORK=y
CONFIG_SCHED_WAITPID=y
CONFIG_SERIAL=y
CONFIG_SFUD_USING_QSPI=y
CONFIG_SFUD_USING_SFDP=y
CONFIG_SPECIFIC_DRIVERS=y
CONFIG_SPI=y
CONFIG_SPI_DRIVER=y
CONFIG_STACK_COLORATION=y
CONFIG_STANDARD_SERIAL=y
CONFIG_SYSLOG_DEFAULT=y
CONFIG_SYSLOG_DEVPATH="/dev/ttyS0"
CONFIG_SYSTEM_DHCPC_RENEW=y
CONFIG_SYSTEM_NETDB=y
CONFIG_SYSTEM_NSH=y
CONFIG_SYSTEM_NXPLAYER=y
CONFIG_SYSTEM_NXRECORDER=y
CONFIG_NXRECORDER_RECORDTHREAD_STACKSIZE=12288
# CONFIG_NXPLAYER_COMMAND_LINE is not set
CONFIG_NXPLAYER_DEFAULT_MEDIADIR="/data"
CONFIG_NXPLAYER_MAINTHREAD_STACKSIZE=12288
CONFIG_NXPLAYER_PLAYTHREAD_STACKSIZE=12288
# CONFIG_SYSTEM_I2CTOOL is not set
CONFIG_SYSTEM_PING=y
CONFIG_WATCHDOG=y
CONFIG_WIRELESS_WAPI=y
CONFIG_WIRELESS_WAPI_CMDTOOL=y
CONFIG_I2CTOOL_MINBUS=2
CONFIG_I2CTOOL_MAXBUS=2
CONFIG_I2CTOOL_MAXREGADDR=0xffff
CONFIG_TASK_NAME_SIZE=16
CONFIG_TTY_SIGINT=y
CONFIG_TTY_SIGINT_CHAR=0x03
CONFIG_UART0_SERIAL_CONSOLE=y
CONFIG_USING_MTD=y
CONFIG_USING_SFUD=y
CONFIG_AIC_QSPI0_BUS_WIDTH_4=y
CONFIG_AIC_QSPI0_DEVICE_SPINOR=y
CONFIG_AIC_QSPI_DRV=y
CONFIG_AIC_QSPI_DRV_V12=y
CONFIG_AIC_SPINOR_DRV=y
CONFIG_AIC_SUPPORT_SPI_IN_BIT_MODE=y
CONFIG_AIC_USING_QSPI0=y
CONFIG_AIC_USING_UART0=y
CONFIG_AIC_USING_AUDIO=y
CONFIG_AIC_USING_DMA=y
CONFIG_AIC_AUDIO_DMIC=y
CONFIG_AIC_AUDIO_PLAYBACK=y
CONFIG_AIC_AUDIO_USE_CPU=y
CONFIG_AIC_AUDIO_PA_ENABLE_GPIO="PD.10"
CONFIG_AIC_AUDIO_EN_PIN_LOW=y
CONFIG_AIC_AUDIO_SPK_1=y
CONFIG_DRIVER_SDMC_HAL_EN=y
CONFIG_AIC_SDMC_DRV=y
CONFIG_AUTO_MOUNT_PATH="/sdcard"
CONFIG_AUTO_MOUNT_FSTYPE="fatfs"
CONFIG_AIC_USING_SDMC0=y
CONFIG_AIC_USING_SDMC1=y
# CONFIG_AIC_USING_SDMC2 is not set
CONFIG_AIC_SDMC0_BUSWIDTH4=y
CONFIG_AIC_SDMC0_CLK_FREQ=100000
CONFIG_AIC_SDMC0_DRV_PHASE=3
CONFIG_AIC_SDMC0_SMP_PHASE=0
CONFIG_AIC_SDMC0_IS_SDIO=y
# CONFIG_AIC_SDMC0_DDR_MODE is not set
# CONFIG_AIC_SDMC0_USING_HOTPLUG is not set
# CONFIG_AIC_SDMC1_BUSWIDTH1 is not set
CONFIG_AIC_SDMC1_BUSWIDTH4=y
CONFIG_AIC_SDMC1_CLK_FREQ=50000
CONFIG_AIC_SDMC1_DRV_PHASE=3
CONFIG_AIC_SDMC1_SMP_PHASE=0
# CONFIG_AIC_SDMC1_DDR_MODE is not set
# CONFIG_AIC_SDMC1_USING_HOTPLUG is not set
CONFIG_AIC_SDMC_IRQ_MODE=y
```

## board/d13x/demo88-nor/pack/d13x_os.its
```
/dts-v1/;

/ {
    description = "nuttx-artinchip firmware";
    #address-cells = <1>;

    images {
        version = "1.0.0";
        seg0 {
            description = "Artinchip D13X segment 0";
            data = /incbin/("./nuttx.bin");
            type = "firmware";
            arch = "riscv";
            os = "artinchip";
            load = <0x30044100>;
            entry = <0x30044100>;
            hash-1 {
                algo = "crc32";
            };
            hash-2 {
                algo = "md5";
            };
        };
    };

    configurations {
        default = "conf-1";
        conf-1 {
            description = "nuttx-artinchip firmware";
            firmware = "seg0";
        };
    };
};
```
